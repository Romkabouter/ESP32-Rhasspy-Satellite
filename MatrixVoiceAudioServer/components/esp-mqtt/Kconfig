## MatrixVoiceAudioServer/components/esp-mqtt/Kconfig
```kconfig
menu "esp-mqtt"

config ESP_MQTT_ENABLED
    bool "Enable the MQTT component"
    select LWIP_SO_RCVBUF
    default y
    help
        This is currently only used to enforce the selection of LWIP_SO_RCVBUF.
        Disabling the component does not actually disable something.

config ESP_MQTT_TASK_STACK_SIZE
    int "MQTT background process task stack size"
    default 4096

config ESP_MQTT_TASK_STACK_PRIORITY
    int "MQTT background process task priority"
    default 5

config ESP_MQTT_EVENT_QUEUE_SIZE
    int "MQTT event queue size"
    default 64
    help
        This value defines the amount of messages that are queued during various
        calls and dispatched by the background process.

endmenu
```

## MatrixVoiceAudioServerNoOTA/main/Kconfig.projbuild
```kconfig
menu "MatrixVoiceAudioServerNoOTA"

config WIFI_SSID
    string "the ssid of the wireless network to connect to"
    default "myssid"

config WIFI_PASS
    string "the passphrase for the specified network"
    default "mypassword"

config MQTT_HOST
    string "mqtt broker to connect to"
    default "localhost"

config MQTT_PORT
    int "mqtt broker port"
    default 1883

config MQTT_USER
    string "mqtt broker username"
    default "try"

config MQTT_PASS
    string "mqtt broker passphrase"
    default "try"

config SITEID
    string "SiteID"
    default "default"
    
endmenu
```
